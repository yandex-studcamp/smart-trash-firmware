## src/Kconfig.projbuild
```kconfig
menu "Smart Trash Firmware"

choice SMART_BOOT_PROFILE
    prompt "Boot Profile"
    default SMART_BOOT_PROFILE_SERVO_TEST

config SMART_BOOT_PROFILE_SERVO_TEST
    bool "Servo smoke test (ESP32-CAM + 2x SG90)"

config SMART_BOOT_PROFILE_INFERENCE_SERVICE
    bool "SoftAP + HTTP inference service"

config SMART_BOOT_PROFILE_CAMERA_CAPTURE_SERVICE
    bool "SoftAP + HTTP camera capture service (periodic photo stream)"

endchoice

if SMART_BOOT_PROFILE_CAMERA_CAPTURE_SERVICE

config SMART_CAMERA_CAPTURE_INTERVAL_SEC
    int "Camera capture interval (seconds)"
    range 1 3600
    default 2
    help
        ESP32-CAM captures one JPEG frame every N seconds and publishes
        latest frame over HTTP endpoint GET /photo.jpg.

endif

menu "Servo settings"

config SMART_SERVO_SAFE_ANGLE_DEG
    int "Safe angle for both servos (deg)"
    range 0 180
    default 90

config SMART_SERVO1_HOME_ANGLE_DEG
    int "Servo #1 home angle (deg)"
    range 0 180
    default 90

config SMART_SERVO2_HOME_ANGLE_DEG
    int "Servo #2 home angle (deg)"
    range 0 180
    default 90

config SMART_SERVO1_TEST_ANGLE_DEG
    int "Servo #1 smoke-test angle (deg)"
    range 0 180
    default 35

config SMART_SERVO2_TEST_ANGLE_DEG
    int "Servo #2 smoke-test angle (deg)"
    range 0 180
    default 145

config SMART_SERVO1_CLASS1_ANGLE_DEG
    int "Servo #1 class 1 action angle (deg)"
    range 0 180
    default 150

config SMART_SERVO1_CLASS2_ANGLE_DEG
    int "Servo #1 class 2 action angle (deg)"
    range 0 180
    default 30

config SMART_SERVO2_ANY_CLASS_ANGLE_DEG
    int "Servo #2 action angle for any class (deg)"
    range 0 180
    default 120

config SMART_SERVO_STARTUP_SETTLE_MS
    int "Delay after initial safe angles (ms)"
    range 0 5000
    default 450

config SMART_SERVO_STEP_DELAY_MS
    int "Delay between smoke-test movements (ms)"
    range 100 10000
    default 900

config SMART_SERVO_SECONDARY_DELAY_MS
    int "Delay before servo #2 action after prediction (ms)"
    range 0 5000
    default 300

config SMART_SERVO_ACTION_HOLD_MS
    int "Servo action hold time before returning home (ms)"
    range 0 10000
    default 700

config SMART_SERVO_ACTION_RETURN_DELAY_MS
    int "Delay between return-home servo commands (ms)"
    range 0 5000
    default 350

endmenu

if SMART_BOOT_PROFILE_INFERENCE_SERVICE

config SMART_BOOT_CAPTURE_AND_INFER
    bool "Capture camera image and run inference on every boot/reset"
    default y

config SMART_ENABLE_HTTP_DEBUG_API
    bool "Enable SoftAP + HTTP debug API"
    default n

config SMART_INFERENCE_SERVO_ACTIONS
    bool "Run servo action after inference result"
    default y

choice SMART_PREDICTION_POLICY
    prompt "Prediction policy"
    default SMART_PREDICTION_POLICY_LEGACY_3_CLASS
    help
        Defines how firmware maps model scores to final prediction.

config SMART_PREDICTION_POLICY_LEGACY_3_CLASS
    bool "Legacy 3-class model (other/paper/plastic)"

config SMART_PREDICTION_POLICY_EXPLICIT_NOTHING_CLASS
    bool "4-class model with explicit 'nothing' class"

config SMART_PREDICTION_POLICY_CONFIDENCE_THRESHOLD
    bool "3-class model + confidence threshold => synthetic 'nothing'"

config SMART_PREDICTION_POLICY_PRESENCE_PREMODEL
    bool "Presence premodel (MSE threshold) + main classifier model"

endchoice

config SMART_NOTHING_CLASS_ID
    int "Class id for 'nothing'"
    range 0 15
    default 3
    depends on SMART_PREDICTION_POLICY_EXPLICIT_NOTHING_CLASS || SMART_PREDICTION_POLICY_CONFIDENCE_THRESHOLD || SMART_PREDICTION_POLICY_PRESENCE_PREMODEL
    help
        In EXPLICIT_NOTHING policy this must match real model class id.
        In CONFIDENCE_THRESHOLD policy this id is emitted when confidence is low.

config SMART_CONFIDENCE_THRESHOLD_PERCENT
    int "Confidence threshold for synthetic 'nothing' (percent)"
    range 0 100
    default 55
    depends on SMART_PREDICTION_POLICY_CONFIDENCE_THRESHOLD
    help
        If max class probability is below this threshold, prediction is
        converted to 'nothing' and servo action is skipped.

config SMART_MODEL_PRIMARY_FILENAME
    string "Primary model filename (.espdl)"
    default "model.espdl"
    help
        Filename in models/ folder for the main classifier model.

config SMART_MODEL_GATE_FILENAME
    string "Presence premodel filename (.espdl)"
    default "premodel.espdl"
    depends on SMART_PREDICTION_POLICY_PRESENCE_PREMODEL
    help
        Filename in models/ folder for gate/presence model (MSE premodel).

config SMART_PRESENCE_MSE_THRESHOLD
    string "Presence premodel MSE threshold"
    default "0.008"
    depends on SMART_PREDICTION_POLICY_PRESENCE_PREMODEL
    help
        Gate premodel outputs one MSE-like scalar.
        If gate_mse <= threshold, firmware emits synthetic 'nothing'.
        If gate_mse > threshold, firmware runs main classifier.
        Use decimal format, for example: 0.0086928317

choice SMART_INFERENCE_TRIGGER_MODE
    prompt "Inference trigger mode"
    default SMART_INFERENCE_TRIGGER_MODE_PERIODIC

config SMART_INFERENCE_TRIGGER_MODE_BUTTON
    bool "Run inference on button press"

config SMART_INFERENCE_TRIGGER_MODE_PERIODIC
    bool "Run inference periodically"

endchoice

config SMART_INFERENCE_PERIOD_SEC
    int "Periodic inference interval (seconds)"
    range 1 3600
    default 5
    depends on SMART_INFERENCE_TRIGGER_MODE_PERIODIC

config SMART_INFERENCE_BUTTON_GPIO
    int "Button GPIO for manual inference trigger"
    range 0 39
    default 0
    depends on SMART_INFERENCE_TRIGGER_MODE_BUTTON
    help
        Default is GPIO0 (BOOT button on many ESP32 boards). Keep button
        released during reset/boot to avoid entering download mode.

config SMART_INFERENCE_BUTTON_ACTIVE_LOW
    bool "Button is active low (pressed = 0)"
    default y
    depends on SMART_INFERENCE_TRIGGER_MODE_BUTTON

config SMART_INFERENCE_BUTTON_DEBOUNCE_MS
    int "Button debounce time (ms)"
    range 10 1000
    default 60
    depends on SMART_INFERENCE_TRIGGER_MODE_BUTTON

config SMART_FLASH_MODEL_WITH_APP
    bool "Flash models/model.espdl together with app"
    default y

config SMART_SAMPLE_DUMP_ENABLE
    bool "Dump captured boot samples to serial log for host-side saving"
    default n
    help
        Debug-only option. When enabled, boot capture emits the RGB frame as
        hex-encoded JPEG chunks to the serial log. A host script can save those
        chunks into logs/samples as numbered artifacts. Keep disabled for
        normal 4MB flash builds.

config SMART_SAMPLE_DUMP_OUTPUT_SIDE
    int "Sample dump output side (square, pixels)"
    range 32 320
    default 128
    depends on SMART_SAMPLE_DUMP_ENABLE
    help
        Captured frame is center-cropped to square and resized to this side.
        Full-resolution RGB over UART is slow enough to trigger task watchdog
        on ESP32-CAM.

if SMART_ENABLE_HTTP_DEBUG_API

config SMART_HTTP_DEBUG_ENABLE_SERVO_ENDPOINTS
    bool "Enable HTTP servo debug endpoints"
    default n
    help
        Adds POST /servo/home, POST /servo/test and POST /servo/set?id=1&angle=90.
        Disabled by default to keep the image as small as possible.

endif

config SMART_INFERENCE_ENABLE_SELF_TEST
    bool "Run model self-test/profile at boot"
    default n

choice SMART_CAMERA_FRAME_SIZE
    prompt "Camera frame size for boot capture"
    default SMART_CAMERA_FRAME_SIZE_QVGA

config SMART_CAMERA_FRAME_SIZE_QQVGA
    bool "QQVGA (160x120)"

config SMART_CAMERA_FRAME_SIZE_QVGA
    bool "QVGA (320x240)"

config SMART_CAMERA_FRAME_SIZE_VGA
    bool "VGA (640x480)"

endchoice

config SMART_CAMERA_JPEG_QUALITY
    int "Camera JPEG quality (lower = better quality)"
    range 5 30
    default 12

config SMART_CAMERA_FB_COUNT
    int "Camera frame buffer count"
    range 1 2
    default 1

config SMART_CAMERA_XCLK_HZ
    int "Camera XCLK frequency (Hz)"
    range 10000000 24000000
    default 20000000

config SMART_CAMERA_PIN_PWDN
    int "Camera PWDN pin"
    default 32

config SMART_CAMERA_PIN_RESET
    int "Camera RESET pin (-1 if not connected)"
    default -1

config SMART_CAMERA_PIN_XCLK
    int "Camera XCLK pin"
    default 0

config SMART_CAMERA_PIN_SIOD
    int "Camera SIOD pin"
    default 26

config SMART_CAMERA_PIN_SIOC
    int "Camera SIOC pin"
    default 27

config SMART_CAMERA_PIN_D7
    int "Camera D7 (Y9) pin"
    default 35

config SMART_CAMERA_PIN_D6
    int "Camera D6 (Y8) pin"
    default 34

config SMART_CAMERA_PIN_D5
    int "Camera D5 (Y7) pin"
    default 39

config SMART_CAMERA_PIN_D4
    int "Camera D4 (Y6) pin"
    default 36

config SMART_CAMERA_PIN_D3
    int "Camera D3 (Y5) pin"
    default 21

config SMART_CAMERA_PIN_D2
    int "Camera D2 (Y4) pin"
    default 19

config SMART_CAMERA_PIN_D1
    int "Camera D1 (Y3) pin"
    default 18

config SMART_CAMERA_PIN_D0
    int "Camera D0 (Y2) pin"
    default 5

config SMART_CAMERA_PIN_VSYNC
    int "Camera VSYNC pin"
    default 25

config SMART_CAMERA_PIN_HREF
    int "Camera HREF pin"
    default 23

config SMART_CAMERA_PIN_PCLK
    int "Camera PCLK pin"
    default 22

endif

if SMART_BOOT_PROFILE_CAMERA_CAPTURE_SERVICE || SMART_ENABLE_HTTP_DEBUG_API

config SMART_SOFTAP_SSID
    string "SoftAP SSID"
    default "smart-trash-cam"

config SMART_SOFTAP_PASSWORD
    string "SoftAP Password"
    default "smartbin1"

config SMART_SOFTAP_CHANNEL
    int "SoftAP Channel"
    range 1 13
    default 6

config SMART_HTTP_SERVER_PORT
    int "HTTP Server Port"
    range 1 65535
    default 80

config SMART_HTTP_MAX_UPLOAD_BYTES
    int "Max Upload Size (bytes)"
    range 1024 1048576
    default 262144

endif

if SMART_BOOT_PROFILE_SERVO_TEST

config SMART_SERVO_TEST_CYCLES
    int "Servo smoke test cycles (0 = infinite)"
    range 0 1000
    default 0

endif

endmenu
```
